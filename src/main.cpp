// Kafkar.com

#include <Arduino.h>
#include <SPI.h>
#include <HardwareSerial.h>
#include "NMEAParser.h"

// Set the RX and TX pins for the GPS module
#define RXD2 22
#define TXD2 27
// Set the baud rate for the GPS module
#define GPS_BAUD 9600
// Create a instance of the HardwareSerial class
HardwareSerial gpsSerial(2);
NMEAParser gpsParser;
bool nmeaSentenceComplete = false;

String nmeaBuffer = "";

// include the installed "TFT_eSPI" library by Bodmer to interface with the TFT Display - https://github.com/Bodmer/TFT_eSPI
#include <TFT_eSPI.h>

// include the installed the "XPT2046_Touchscreen" library by Paul Stoffregen to use the Touchscreen - https://github.com/PaulStoffregen/XPT2046_Touchscreen
#include <XPT2046_Touchscreen.h>

// Create a instance of the TFT_eSPI class
TFT_eSPI tft = TFT_eSPI();

// Set the pius of the xpt2046 touchscreen
#define XPT2046_IRQ 36  // T_IRQ
#define XPT2046_MOSI 32 // T_DIN
#define XPT2046_MISO 39 // T_OUT
#define XPT2046_CLK 25  // T_CLK
#define XPT2046_CS 33   // T_CS

// Create a instance of the SPIClass and XPT2046_Touchscreen classes
SPIClass touchscreenSPI = SPIClass(VSPI);
XPT2046_Touchscreen touchscreen(XPT2046_CS, XPT2046_IRQ);

#define SCREEN_WIDTH 320
#define SCREEN_HEIGHT 240
#define FONT_SIZE 2

// Global Variables
int posX;     // x position of the touch
int posY;     // y position of the touch
int pressure; // pressure of the touch

// Set X and Y coordinates for center of display
int centerX;
int centerY;



const unsigned char bitmap_kafkar_logo[] PROGMEM = {
    0x00, 0x00, 0x00, 0x00, 0x00, 0x00, 0x00, 0x00, 0x07, 0x80, 0x00, 0x00, 0x00, 0x00, 0x00, 0x00,
    0x00, 0x00, 0x00, 0x00, 0x00, 0x00, 0x00, 0x1f, 0xe0, 0x00, 0x00, 0x00, 0x00, 0x00, 0x00, 0x00,
    0x00, 0x00, 0x00, 0x00, 0x00, 0x00, 0x1f, 0xe0, 0x00, 0x00, 0x00, 0x00, 0x00, 0x00, 0x00, 0x00,
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    0x03, 0xff, 0x00, 0x00, 0x00, 0x00, 0x00, 0x00, 0x00, 0x00, 0x00, 0x00};

    
void logTouchData(int posX, int posY, int pressure)
{
  Serial.print("X = ");
  Serial.print(posX);
  Serial.print(" | Y = ");
  Serial.print(posY);
  Serial.print(" | Pressure = ");
  Serial.print(pressure);
  Serial.println();
}


void setup()
{
  Serial.begin(115200);

  // Start the GPS module
  gpsSerial.begin(GPS_BAUD, SERIAL_8N1, RXD2, TXD2);

  // Start the touchscreen component and init the touchscreen
  touchscreenSPI.begin(XPT2046_CLK, XPT2046_MISO, XPT2046_MOSI, XPT2046_CS);

  touchscreen.begin(touchscreenSPI);

  // Set the Touchscreen rotation in landscape mode
  touchscreen.setRotation(1);

  // Start the tft display
  tft.init();

  // Set the TFT display rotation in landscape mode
  tft.setRotation(1);

  // Clear the screen and display a message
  tft.fillScreen(TFT_BLACK);
  tft.setTextColor(TFT_WHITE, TFT_BLACK);

  // Set X and Y coordinates for center of display
  centerX = SCREEN_WIDTH / 2;
  centerY = SCREEN_HEIGHT / 2;

  tft.drawCentreString("Hello, Kafkar.com!", centerX, 30, FONT_SIZE);
  tft.drawCentreString("GPS/GNSS test", centerX, 200, FONT_SIZE);

  int x = (tft.width() - 116) / 2;
  int y = (tft.height() - 110) / 2;

  // Draw the Kafkar logo bitmap
  tft.drawBitmap(x, y, bitmap_kafkar_logo, 116, 100, TFT_WHITE);
}

void updateGPSDisplay(NMEAParser& parser) {
  tft.setTextColor(TFT_WHITE, TFT_BLACK);
  
  // Static variables to store previous values for comparison
  static double prevLat = 0.0;
  static double prevLon = 0.0;
  static double prevSpeed = 0.0;
  static double prevCourse = 0.0;
  static int prevSats = 0;
  static String prevTime = "";
  
  // Get current values
  double currentLat = parser.getLatitude();
  double currentLon = parser.getLongitude();
  double currentSpeed = parser.getSpeed() * 1.852; // Convert knots to km/h
  double currentCourse = parser.getCourse();
  int currentSats = parser.getSatellites();
  String currentTime = parser.getTimeString().c_str();
  
   // Print parsed values to serial port
   Serial.println("\n----- GPS Data -----");
   Serial.print("Time: "); Serial.println(currentTime);
   Serial.print("Latitude: "); Serial.println(currentLat, 6);
   Serial.print("Longitude: "); Serial.println(currentLon, 6);
   Serial.print("Speed: "); Serial.print(currentSpeed, 1); Serial.println(" km/h");
   Serial.print("Course: "); Serial.print(currentCourse, 1); Serial.println("°");
   Serial.print("Satellites: "); Serial.println(currentSats);
   Serial.println("-------------------");
   
  // Update satellite count if changed
  if (currentSats != prevSats) {
    tft.fillRect(120, 50, 100, 20, TFT_BLACK); // Clear previous value area
    tft.drawString(String(currentSats), 120, 50, FONT_SIZE);
    prevSats = currentSats;
  }
  
  // Update latitude if changed
  if (currentLat != prevLat) {
    tft.fillRect(60, 70, 200, 20, TFT_BLACK); // Clear previous value area
    tft.drawString(String(currentLat, 6), 60, 70, FONT_SIZE);
    prevLat = currentLat;
  }
  
  // Update longitude if changed
  if (currentLon != prevLon) {
    tft.fillRect(60, 90, 200, 20, TFT_BLACK); // Clear previous value area
    tft.drawString(String(currentLon, 6), 60, 90, FONT_SIZE);
    prevLon = currentLon;
  }
  
  // Update speed if changed
  if (currentSpeed != prevSpeed) {
    tft.fillRect(80, 110, 120, 20, TFT_BLACK); // Clear previous value area
    tft.drawString(String(currentSpeed, 1) + " km/h", 80, 110, FONT_SIZE);
    prevSpeed = currentSpeed;
  }
  
  // Update course if changed
  if (currentCourse != prevCourse) {
    tft.fillRect(90, 130, 100, 20, TFT_BLACK); // Clear previous value area
    tft.drawString(String(currentCourse, 1) + "°", 90, 130, FONT_SIZE);
    prevCourse = currentCourse;
  }
  
  // Update time if changed
  if (currentTime != prevTime && currentTime.length() > 0) {
    tft.fillRect(60, 150, 100, 20, TFT_BLACK); // Clear previous value area
    tft.drawString(currentTime, 60, 150, FONT_SIZE);
    prevTime = currentTime;
  }
  
  // Draw static labels only once during first call
  static bool firstRun = true;
  if (firstRun) {
    tft.fillRect(0, 50, SCREEN_WIDTH, 150, TFT_BLACK); // Clear entire data area
    tft.drawString("Satellites:", 10, 50, FONT_SIZE);
    tft.drawString("Lat:", 10, 70, FONT_SIZE);
    tft.drawString("Lon:", 10, 90, FONT_SIZE);
    tft.drawString("Speed:", 10, 110, FONT_SIZE);
    tft.drawString("Course:", 10, 130, FONT_SIZE);
    tft.drawString("Time:", 10, 150, FONT_SIZE);
    firstRun = false;
  }
}

void loop()
{
  static unsigned long lastUpdate = 0;
  
  // Checks if Touchscreen is touched
  if (touchscreen.tirqTouched() && touchscreen.touched())
  {
    // Get Touchscreen points
    TS_Point p = touchscreen.getPoint();
    // Calibrate Touchscreen points with map function to the correct width and height
    posX = map(p.x, 200, 3700, 1, SCREEN_WIDTH);
    posY = map(p.y, 240, 3800, 1, SCREEN_HEIGHT);
    pressure = p.z;
    // logTouchData(posX, posY, pressure);

    delay(100);
  }

  // Read GPS data from Serial2 (UART2)
  while (gpsSerial.available() > 0) {
    // get the byte data from the GPS
    char gpsData = gpsSerial.read();
    
    // Process the GPS data with our parser
    if (nmeaSentenceComplete) {
      for (unsigned int i = 0; i < nmeaBuffer.length(); i++) {
        gpsParser.processGPSData(nmeaBuffer[i]);
      }
      nmeaBuffer = "";
      nmeaSentenceComplete = false;
      
      // Update display every 500ms
      if (millis() - lastUpdate > 500) {
        updateGPSDisplay(gpsParser);
        lastUpdate = millis();
      }
    }
    
    // Collect NMEA data
    nmeaBuffer += gpsData;
    
    // Check for end of NMEA sentence
    if (gpsData == '\n') {
      nmeaSentenceComplete = true;
      Serial.println(gpsData);
    }
    
    // Echo to serial monitor for debugging
    Serial.print(gpsData);
  }
}
